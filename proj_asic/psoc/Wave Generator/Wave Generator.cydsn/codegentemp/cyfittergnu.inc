.ifndef INCLUDED_CYFITTERGNU_INC
.set INCLUDED_CYFITTERGNU_INC, 1
.include "cydevicegnu.inc"
.include "cydevicegnu_trm.inc"

/* TX */
.set TX__0__INTTYPE, CYREG_PICU2_INTTYPE7
.set TX__0__MASK, 0x80
.set TX__0__PC, CYREG_PRT2_PC7
.set TX__0__PORT, 2
.set TX__0__SHIFT, 7
.set TX__AG, CYREG_PRT2_AG
.set TX__AMUX, CYREG_PRT2_AMUX
.set TX__BIE, CYREG_PRT2_BIE
.set TX__BIT_MASK, CYREG_PRT2_BIT_MASK
.set TX__BYP, CYREG_PRT2_BYP
.set TX__CTL, CYREG_PRT2_CTL
.set TX__DM0, CYREG_PRT2_DM0
.set TX__DM1, CYREG_PRT2_DM1
.set TX__DM2, CYREG_PRT2_DM2
.set TX__DR, CYREG_PRT2_DR
.set TX__INP_DIS, CYREG_PRT2_INP_DIS
.set TX__INTTYPE_BASE, CYDEV_PICU_INTTYPE_PICU2_BASE
.set TX__LCD_COM_SEG, CYREG_PRT2_LCD_COM_SEG
.set TX__LCD_EN, CYREG_PRT2_LCD_EN
.set TX__MASK, 0x80
.set TX__PORT, 2
.set TX__PRT, CYREG_PRT2_PRT
.set TX__PRTDSI__CAPS_SEL, CYREG_PRT2_CAPS_SEL
.set TX__PRTDSI__DBL_SYNC_IN, CYREG_PRT2_DBL_SYNC_IN
.set TX__PRTDSI__OE_SEL0, CYREG_PRT2_OE_SEL0
.set TX__PRTDSI__OE_SEL1, CYREG_PRT2_OE_SEL1
.set TX__PRTDSI__OUT_SEL0, CYREG_PRT2_OUT_SEL0
.set TX__PRTDSI__OUT_SEL1, CYREG_PRT2_OUT_SEL1
.set TX__PRTDSI__SYNC_OUT, CYREG_PRT2_SYNC_OUT
.set TX__PS, CYREG_PRT2_PS
.set TX__SHIFT, 7
.set TX__SLW, CYREG_PRT2_SLW

/* WS */
.set WS__0__INTTYPE, CYREG_PICU4_INTTYPE2
.set WS__0__MASK, 0x04
.set WS__0__PC, CYREG_PRT4_PC2
.set WS__0__PORT, 4
.set WS__0__SHIFT, 2
.set WS__AG, CYREG_PRT4_AG
.set WS__AMUX, CYREG_PRT4_AMUX
.set WS__BIE, CYREG_PRT4_BIE
.set WS__BIT_MASK, CYREG_PRT4_BIT_MASK
.set WS__BYP, CYREG_PRT4_BYP
.set WS__CTL, CYREG_PRT4_CTL
.set WS__DM0, CYREG_PRT4_DM0
.set WS__DM1, CYREG_PRT4_DM1
.set WS__DM2, CYREG_PRT4_DM2
.set WS__DR, CYREG_PRT4_DR
.set WS__INP_DIS, CYREG_PRT4_INP_DIS
.set WS__INTTYPE_BASE, CYDEV_PICU_INTTYPE_PICU4_BASE
.set WS__LCD_COM_SEG, CYREG_PRT4_LCD_COM_SEG
.set WS__LCD_EN, CYREG_PRT4_LCD_EN
.set WS__MASK, 0x04
.set WS__PORT, 4
.set WS__PRT, CYREG_PRT4_PRT
.set WS__PRTDSI__CAPS_SEL, CYREG_PRT4_CAPS_SEL
.set WS__PRTDSI__DBL_SYNC_IN, CYREG_PRT4_DBL_SYNC_IN
.set WS__PRTDSI__OE_SEL0, CYREG_PRT4_OE_SEL0
.set WS__PRTDSI__OE_SEL1, CYREG_PRT4_OE_SEL1
.set WS__PRTDSI__OUT_SEL0, CYREG_PRT4_OUT_SEL0
.set WS__PRTDSI__OUT_SEL1, CYREG_PRT4_OUT_SEL1
.set WS__PRTDSI__SYNC_OUT, CYREG_PRT4_SYNC_OUT
.set WS__PS, CYREG_PRT4_PS
.set WS__SHIFT, 2
.set WS__SLW, CYREG_PRT4_SLW

/* ADC_DEC */
.set ADC_DEC__COHER, CYREG_DEC_COHER
.set ADC_DEC__CR, CYREG_DEC_CR
.set ADC_DEC__DR1, CYREG_DEC_DR1
.set ADC_DEC__DR2, CYREG_DEC_DR2
.set ADC_DEC__DR2H, CYREG_DEC_DR2H
.set ADC_DEC__GCOR, CYREG_DEC_GCOR
.set ADC_DEC__GCORH, CYREG_DEC_GCORH
.set ADC_DEC__GVAL, CYREG_DEC_GVAL
.set ADC_DEC__OCOR, CYREG_DEC_OCOR
.set ADC_DEC__OCORH, CYREG_DEC_OCORH
.set ADC_DEC__OCORM, CYREG_DEC_OCORM
.set ADC_DEC__OUTSAMP, CYREG_DEC_OUTSAMP
.set ADC_DEC__OUTSAMPH, CYREG_DEC_OUTSAMPH
.set ADC_DEC__OUTSAMPM, CYREG_DEC_OUTSAMPM
.set ADC_DEC__OUTSAMPS, CYREG_DEC_OUTSAMPS
.set ADC_DEC__PM_ACT_CFG, CYREG_PM_ACT_CFG10
.set ADC_DEC__PM_ACT_MSK, 0x01
.set ADC_DEC__PM_STBY_CFG, CYREG_PM_STBY_CFG10
.set ADC_DEC__PM_STBY_MSK, 0x01
.set ADC_DEC__SHIFT1, CYREG_DEC_SHIFT1
.set ADC_DEC__SHIFT2, CYREG_DEC_SHIFT2
.set ADC_DEC__SR, CYREG_DEC_SR
.set ADC_DEC__TRIM__M1, CYREG_FLSHID_CUST_TABLES_DEC_M1
.set ADC_DEC__TRIM__M2, CYREG_FLSHID_CUST_TABLES_DEC_M2
.set ADC_DEC__TRIM__M3, CYREG_FLSHID_CUST_TABLES_DEC_M3
.set ADC_DEC__TRIM__M4, CYREG_FLSHID_CUST_TABLES_DEC_M4
.set ADC_DEC__TRIM__M5, CYREG_FLSHID_CUST_TABLES_DEC_M5
.set ADC_DEC__TRIM__M6, CYREG_FLSHID_CUST_TABLES_DEC_M6
.set ADC_DEC__TRIM__M7, CYREG_FLSHID_CUST_TABLES_DEC_M7
.set ADC_DEC__TRIM__M8, CYREG_FLSHID_CUST_TABLES_DEC_M8

/* ADC_DSM */
.set ADC_DSM__BUF0, CYREG_DSM0_BUF0
.set ADC_DSM__BUF1, CYREG_DSM0_BUF1
.set ADC_DSM__BUF2, CYREG_DSM0_BUF2
.set ADC_DSM__BUF3, CYREG_DSM0_BUF3
.set ADC_DSM__CLK, CYREG_DSM0_CLK
.set ADC_DSM__CR0, CYREG_DSM0_CR0
.set ADC_DSM__CR1, CYREG_DSM0_CR1
.set ADC_DSM__CR10, CYREG_DSM0_CR10
.set ADC_DSM__CR11, CYREG_DSM0_CR11
.set ADC_DSM__CR12, CYREG_DSM0_CR12
.set ADC_DSM__CR13, CYREG_DSM0_CR13
.set ADC_DSM__CR14, CYREG_DSM0_CR14
.set ADC_DSM__CR15, CYREG_DSM0_CR15
.set ADC_DSM__CR16, CYREG_DSM0_CR16
.set ADC_DSM__CR17, CYREG_DSM0_CR17
.set ADC_DSM__CR2, CYREG_DSM0_CR2
.set ADC_DSM__CR3, CYREG_DSM0_CR3
.set ADC_DSM__CR4, CYREG_DSM0_CR4
.set ADC_DSM__CR5, CYREG_DSM0_CR5
.set ADC_DSM__CR6, CYREG_DSM0_CR6
.set ADC_DSM__CR7, CYREG_DSM0_CR7
.set ADC_DSM__CR8, CYREG_DSM0_CR8
.set ADC_DSM__CR9, CYREG_DSM0_CR9
.set ADC_DSM__DEM0, CYREG_DSM0_DEM0
.set ADC_DSM__DEM1, CYREG_DSM0_DEM1
.set ADC_DSM__MISC, CYREG_DSM0_MISC
.set ADC_DSM__OUT0, CYREG_DSM0_OUT0
.set ADC_DSM__OUT1, CYREG_DSM0_OUT1
.set ADC_DSM__REF0, CYREG_DSM0_REF0
.set ADC_DSM__REF1, CYREG_DSM0_REF1
.set ADC_DSM__REF2, CYREG_DSM0_REF2
.set ADC_DSM__REF3, CYREG_DSM0_REF3
.set ADC_DSM__RSVD1, CYREG_DSM0_RSVD1
.set ADC_DSM__SW0, CYREG_DSM0_SW0
.set ADC_DSM__SW2, CYREG_DSM0_SW2
.set ADC_DSM__SW3, CYREG_DSM0_SW3
.set ADC_DSM__SW4, CYREG_DSM0_SW4
.set ADC_DSM__SW6, CYREG_DSM0_SW6
.set ADC_DSM__TR0, CYREG_NPUMP_DSM_TR0
.set ADC_DSM__TST0, CYREG_DSM0_TST0
.set ADC_DSM__TST1, CYREG_DSM0_TST1

/* ADC_Ext_CP_Clk */
.set ADC_Ext_CP_Clk__CFG0, CYREG_CLKDIST_DCFG0_CFG0
.set ADC_Ext_CP_Clk__CFG1, CYREG_CLKDIST_DCFG0_CFG1
.set ADC_Ext_CP_Clk__CFG2, CYREG_CLKDIST_DCFG0_CFG2
.set ADC_Ext_CP_Clk__CFG2_SRC_SEL_MASK, 0x07
.set ADC_Ext_CP_Clk__INDEX, 0x00
.set ADC_Ext_CP_Clk__PM_ACT_CFG, CYREG_PM_ACT_CFG2
.set ADC_Ext_CP_Clk__PM_ACT_MSK, 0x01
.set ADC_Ext_CP_Clk__PM_STBY_CFG, CYREG_PM_STBY_CFG2
.set ADC_Ext_CP_Clk__PM_STBY_MSK, 0x01

/* ADC_IRQ */
.set ADC_IRQ__INTC_CLR_EN_REG, CYREG_NVIC_CLRENA0
.set ADC_IRQ__INTC_CLR_PD_REG, CYREG_NVIC_CLRPEND0
.set ADC_IRQ__INTC_MASK, 0x20000000
.set ADC_IRQ__INTC_NUMBER, 29
.set ADC_IRQ__INTC_PRIOR_NUM, 7
.set ADC_IRQ__INTC_PRIOR_REG, CYREG_NVIC_PRI_29
.set ADC_IRQ__INTC_SET_EN_REG, CYREG_NVIC_SETENA0
.set ADC_IRQ__INTC_SET_PD_REG, CYREG_NVIC_SETPEND0

/* ADC_theACLK */
.set ADC_theACLK__CFG0, CYREG_CLKDIST_ACFG0_CFG0
.set ADC_theACLK__CFG1, CYREG_CLKDIST_ACFG0_CFG1
.set ADC_theACLK__CFG2, CYREG_CLKDIST_ACFG0_CFG2
.set ADC_theACLK__CFG2_SRC_SEL_MASK, 0x07
.set ADC_theACLK__CFG3, CYREG_CLKDIST_ACFG0_CFG3
.set ADC_theACLK__CFG3_PHASE_DLY_MASK, 0x0F
.set ADC_theACLK__INDEX, 0x00
.set ADC_theACLK__PM_ACT_CFG, CYREG_PM_ACT_CFG1
.set ADC_theACLK__PM_ACT_MSK, 0x01
.set ADC_theACLK__PM_STBY_CFG, CYREG_PM_STBY_CFG1
.set ADC_theACLK__PM_STBY_MSK, 0x01

/* I2S_bI2S */
.set I2S_bI2S_BitCounter__16BIT_CONTROL_AUX_CTL_REG, CYREG_B0_UDB02_03_ACTL
.set I2S_bI2S_BitCounter__16BIT_CONTROL_CONTROL_REG, CYREG_B0_UDB02_03_CTL
.set I2S_bI2S_BitCounter__16BIT_CONTROL_COUNT_REG, CYREG_B0_UDB02_03_CTL
.set I2S_bI2S_BitCounter__16BIT_COUNT_CONTROL_REG, CYREG_B0_UDB02_03_CTL
.set I2S_bI2S_BitCounter__16BIT_COUNT_COUNT_REG, CYREG_B0_UDB02_03_CTL
.set I2S_bI2S_BitCounter__16BIT_MASK_MASK_REG, CYREG_B0_UDB02_03_MSK
.set I2S_bI2S_BitCounter__16BIT_MASK_PERIOD_REG, CYREG_B0_UDB02_03_MSK
.set I2S_bI2S_BitCounter__16BIT_PERIOD_MASK_REG, CYREG_B0_UDB02_03_MSK
.set I2S_bI2S_BitCounter__16BIT_PERIOD_PERIOD_REG, CYREG_B0_UDB02_03_MSK
.set I2S_bI2S_BitCounter__CONTROL_AUX_CTL_REG, CYREG_B0_UDB02_ACTL
.set I2S_bI2S_BitCounter__CONTROL_REG, CYREG_B0_UDB02_CTL
.set I2S_bI2S_BitCounter__CONTROL_ST_REG, CYREG_B0_UDB02_ST_CTL
.set I2S_bI2S_BitCounter__COUNT_REG, CYREG_B0_UDB02_CTL
.set I2S_bI2S_BitCounter__COUNT_ST_REG, CYREG_B0_UDB02_ST_CTL
.set I2S_bI2S_BitCounter__MASK_CTL_AUX_CTL_REG, CYREG_B0_UDB02_MSK_ACTL
.set I2S_bI2S_BitCounter__PER_CTL_AUX_CTL_REG, CYREG_B0_UDB02_MSK_ACTL
.set I2S_bI2S_BitCounter__PERIOD_REG, CYREG_B0_UDB02_MSK
.set I2S_bI2S_BitCounter_ST__16BIT_STATUS_AUX_CTL_REG, CYREG_B0_UDB02_03_ACTL
.set I2S_bI2S_BitCounter_ST__16BIT_STATUS_REG, CYREG_B0_UDB02_03_ST
.set I2S_bI2S_BitCounter_ST__MASK_REG, CYREG_B0_UDB02_MSK
.set I2S_bI2S_BitCounter_ST__MASK_ST_AUX_CTL_REG, CYREG_B0_UDB02_MSK_ACTL
.set I2S_bI2S_BitCounter_ST__PER_ST_AUX_CTL_REG, CYREG_B0_UDB02_MSK_ACTL
.set I2S_bI2S_BitCounter_ST__STATUS_AUX_CTL_REG, CYREG_B0_UDB02_ACTL
.set I2S_bI2S_BitCounter_ST__STATUS_CNT_REG, CYREG_B0_UDB02_ST_CTL
.set I2S_bI2S_BitCounter_ST__STATUS_CONTROL_REG, CYREG_B0_UDB02_ST_CTL
.set I2S_bI2S_BitCounter_ST__STATUS_REG, CYREG_B0_UDB02_ST
.set I2S_bI2S_CtlReg__0__MASK, 0x01
.set I2S_bI2S_CtlReg__0__POS, 0
.set I2S_bI2S_CtlReg__1__MASK, 0x02
.set I2S_bI2S_CtlReg__1__POS, 1
.set I2S_bI2S_CtlReg__16BIT_CONTROL_AUX_CTL_REG, CYREG_B0_UDB01_02_ACTL
.set I2S_bI2S_CtlReg__16BIT_CONTROL_CONTROL_REG, CYREG_B0_UDB01_02_CTL
.set I2S_bI2S_CtlReg__16BIT_CONTROL_COUNT_REG, CYREG_B0_UDB01_02_CTL
.set I2S_bI2S_CtlReg__16BIT_COUNT_CONTROL_REG, CYREG_B0_UDB01_02_CTL
.set I2S_bI2S_CtlReg__16BIT_COUNT_COUNT_REG, CYREG_B0_UDB01_02_CTL
.set I2S_bI2S_CtlReg__16BIT_MASK_MASK_REG, CYREG_B0_UDB01_02_MSK
.set I2S_bI2S_CtlReg__16BIT_MASK_PERIOD_REG, CYREG_B0_UDB01_02_MSK
.set I2S_bI2S_CtlReg__16BIT_PERIOD_MASK_REG, CYREG_B0_UDB01_02_MSK
.set I2S_bI2S_CtlReg__16BIT_PERIOD_PERIOD_REG, CYREG_B0_UDB01_02_MSK
.set I2S_bI2S_CtlReg__2__MASK, 0x04
.set I2S_bI2S_CtlReg__2__POS, 2
.set I2S_bI2S_CtlReg__CONTROL_AUX_CTL_REG, CYREG_B0_UDB01_ACTL
.set I2S_bI2S_CtlReg__CONTROL_REG, CYREG_B0_UDB01_CTL
.set I2S_bI2S_CtlReg__CONTROL_ST_REG, CYREG_B0_UDB01_ST_CTL
.set I2S_bI2S_CtlReg__COUNT_REG, CYREG_B0_UDB01_CTL
.set I2S_bI2S_CtlReg__COUNT_ST_REG, CYREG_B0_UDB01_ST_CTL
.set I2S_bI2S_CtlReg__MASK, 0x07
.set I2S_bI2S_CtlReg__MASK_CTL_AUX_CTL_REG, CYREG_B0_UDB01_MSK_ACTL
.set I2S_bI2S_CtlReg__PER_CTL_AUX_CTL_REG, CYREG_B0_UDB01_MSK_ACTL
.set I2S_bI2S_CtlReg__PERIOD_REG, CYREG_B0_UDB01_MSK
.set I2S_bI2S_Rx_CH_0__dpRx_u0__16BIT_A0_REG, CYREG_B0_UDB05_06_A0
.set I2S_bI2S_Rx_CH_0__dpRx_u0__16BIT_A1_REG, CYREG_B0_UDB05_06_A1
.set I2S_bI2S_Rx_CH_0__dpRx_u0__16BIT_D0_REG, CYREG_B0_UDB05_06_D0
.set I2S_bI2S_Rx_CH_0__dpRx_u0__16BIT_D1_REG, CYREG_B0_UDB05_06_D1
.set I2S_bI2S_Rx_CH_0__dpRx_u0__16BIT_DP_AUX_CTL_REG, CYREG_B0_UDB05_06_ACTL
.set I2S_bI2S_Rx_CH_0__dpRx_u0__16BIT_F0_REG, CYREG_B0_UDB05_06_F0
.set I2S_bI2S_Rx_CH_0__dpRx_u0__16BIT_F1_REG, CYREG_B0_UDB05_06_F1
.set I2S_bI2S_Rx_CH_0__dpRx_u0__A0_A1_REG, CYREG_B0_UDB05_A0_A1
.set I2S_bI2S_Rx_CH_0__dpRx_u0__A0_REG, CYREG_B0_UDB05_A0
.set I2S_bI2S_Rx_CH_0__dpRx_u0__A1_REG, CYREG_B0_UDB05_A1
.set I2S_bI2S_Rx_CH_0__dpRx_u0__D0_D1_REG, CYREG_B0_UDB05_D0_D1
.set I2S_bI2S_Rx_CH_0__dpRx_u0__D0_REG, CYREG_B0_UDB05_D0
.set I2S_bI2S_Rx_CH_0__dpRx_u0__D1_REG, CYREG_B0_UDB05_D1
.set I2S_bI2S_Rx_CH_0__dpRx_u0__DP_AUX_CTL_REG, CYREG_B0_UDB05_ACTL
.set I2S_bI2S_Rx_CH_0__dpRx_u0__F0_F1_REG, CYREG_B0_UDB05_F0_F1
.set I2S_bI2S_Rx_CH_0__dpRx_u0__F0_REG, CYREG_B0_UDB05_F0
.set I2S_bI2S_Rx_CH_0__dpRx_u0__F1_REG, CYREG_B0_UDB05_F1
.set I2S_bI2S_Rx_STS_0__Sts__0__MASK, 0x01
.set I2S_bI2S_Rx_STS_0__Sts__0__POS, 0
.set I2S_bI2S_Rx_STS_0__Sts__1__MASK, 0x02
.set I2S_bI2S_Rx_STS_0__Sts__1__POS, 1
.set I2S_bI2S_Rx_STS_0__Sts__16BIT_STATUS_AUX_CTL_REG, CYREG_B0_UDB05_06_ACTL
.set I2S_bI2S_Rx_STS_0__Sts__16BIT_STATUS_REG, CYREG_B0_UDB05_06_ST
.set I2S_bI2S_Rx_STS_0__Sts__2__MASK, 0x04
.set I2S_bI2S_Rx_STS_0__Sts__2__POS, 2
.set I2S_bI2S_Rx_STS_0__Sts__MASK, 0x07
.set I2S_bI2S_Rx_STS_0__Sts__MASK_REG, CYREG_B0_UDB05_MSK
.set I2S_bI2S_Rx_STS_0__Sts__STATUS_AUX_CTL_REG, CYREG_B0_UDB05_ACTL
.set I2S_bI2S_Rx_STS_0__Sts__STATUS_REG, CYREG_B0_UDB05_ST
.set I2S_bI2S_Tx_CH_0__dpTx_u0__16BIT_A0_REG, CYREG_B0_UDB01_02_A0
.set I2S_bI2S_Tx_CH_0__dpTx_u0__16BIT_A1_REG, CYREG_B0_UDB01_02_A1
.set I2S_bI2S_Tx_CH_0__dpTx_u0__16BIT_D0_REG, CYREG_B0_UDB01_02_D0
.set I2S_bI2S_Tx_CH_0__dpTx_u0__16BIT_D1_REG, CYREG_B0_UDB01_02_D1
.set I2S_bI2S_Tx_CH_0__dpTx_u0__16BIT_DP_AUX_CTL_REG, CYREG_B0_UDB01_02_ACTL
.set I2S_bI2S_Tx_CH_0__dpTx_u0__16BIT_F0_REG, CYREG_B0_UDB01_02_F0
.set I2S_bI2S_Tx_CH_0__dpTx_u0__16BIT_F1_REG, CYREG_B0_UDB01_02_F1
.set I2S_bI2S_Tx_CH_0__dpTx_u0__A0_A1_REG, CYREG_B0_UDB01_A0_A1
.set I2S_bI2S_Tx_CH_0__dpTx_u0__A0_REG, CYREG_B0_UDB01_A0
.set I2S_bI2S_Tx_CH_0__dpTx_u0__A1_REG, CYREG_B0_UDB01_A1
.set I2S_bI2S_Tx_CH_0__dpTx_u0__D0_D1_REG, CYREG_B0_UDB01_D0_D1
.set I2S_bI2S_Tx_CH_0__dpTx_u0__D0_REG, CYREG_B0_UDB01_D0
.set I2S_bI2S_Tx_CH_0__dpTx_u0__D1_REG, CYREG_B0_UDB01_D1
.set I2S_bI2S_Tx_CH_0__dpTx_u0__DP_AUX_CTL_REG, CYREG_B0_UDB01_ACTL
.set I2S_bI2S_Tx_CH_0__dpTx_u0__F0_F1_REG, CYREG_B0_UDB01_F0_F1
.set I2S_bI2S_Tx_CH_0__dpTx_u0__F0_REG, CYREG_B0_UDB01_F0
.set I2S_bI2S_Tx_CH_0__dpTx_u0__F1_REG, CYREG_B0_UDB01_F1
.set I2S_bI2S_Tx_CH_0__dpTx_u0__MSK_DP_AUX_CTL_REG, CYREG_B0_UDB01_MSK_ACTL
.set I2S_bI2S_Tx_CH_0__dpTx_u0__PER_DP_AUX_CTL_REG, CYREG_B0_UDB01_MSK_ACTL
.set I2S_bI2S_Tx_STS_0__Sts__0__MASK, 0x01
.set I2S_bI2S_Tx_STS_0__Sts__0__POS, 0
.set I2S_bI2S_Tx_STS_0__Sts__1__MASK, 0x02
.set I2S_bI2S_Tx_STS_0__Sts__1__POS, 1
.set I2S_bI2S_Tx_STS_0__Sts__16BIT_STATUS_AUX_CTL_REG, CYREG_B0_UDB01_02_ACTL
.set I2S_bI2S_Tx_STS_0__Sts__16BIT_STATUS_REG, CYREG_B0_UDB01_02_ST
.set I2S_bI2S_Tx_STS_0__Sts__2__MASK, 0x04
.set I2S_bI2S_Tx_STS_0__Sts__2__POS, 2
.set I2S_bI2S_Tx_STS_0__Sts__MASK, 0x07
.set I2S_bI2S_Tx_STS_0__Sts__MASK_REG, CYREG_B0_UDB01_MSK
.set I2S_bI2S_Tx_STS_0__Sts__MASK_ST_AUX_CTL_REG, CYREG_B0_UDB01_MSK_ACTL
.set I2S_bI2S_Tx_STS_0__Sts__PER_ST_AUX_CTL_REG, CYREG_B0_UDB01_MSK_ACTL
.set I2S_bI2S_Tx_STS_0__Sts__STATUS_AUX_CTL_REG, CYREG_B0_UDB01_ACTL
.set I2S_bI2S_Tx_STS_0__Sts__STATUS_CNT_REG, CYREG_B0_UDB01_ST_CTL
.set I2S_bI2S_Tx_STS_0__Sts__STATUS_CONTROL_REG, CYREG_B0_UDB01_ST_CTL
.set I2S_bI2S_Tx_STS_0__Sts__STATUS_REG, CYREG_B0_UDB01_ST

/* I2S_Clock */
.set I2S_Clock__CFG0, CYREG_CLKDIST_DCFG1_CFG0
.set I2S_Clock__CFG1, CYREG_CLKDIST_DCFG1_CFG1
.set I2S_Clock__CFG2, CYREG_CLKDIST_DCFG1_CFG2
.set I2S_Clock__CFG2_SRC_SEL_MASK, 0x07
.set I2S_Clock__INDEX, 0x01
.set I2S_Clock__PM_ACT_CFG, CYREG_PM_ACT_CFG2
.set I2S_Clock__PM_ACT_MSK, 0x02
.set I2S_Clock__PM_STBY_CFG, CYREG_PM_STBY_CFG2
.set I2S_Clock__PM_STBY_MSK, 0x02

/* SCK */
.set SCK__0__INTTYPE, CYREG_PICU4_INTTYPE0
.set SCK__0__MASK, 0x01
.set SCK__0__PC, CYREG_PRT4_PC0
.set SCK__0__PORT, 4
.set SCK__0__SHIFT, 0
.set SCK__AG, CYREG_PRT4_AG
.set SCK__AMUX, CYREG_PRT4_AMUX
.set SCK__BIE, CYREG_PRT4_BIE
.set SCK__BIT_MASK, CYREG_PRT4_BIT_MASK
.set SCK__BYP, CYREG_PRT4_BYP
.set SCK__CTL, CYREG_PRT4_CTL
.set SCK__DM0, CYREG_PRT4_DM0
.set SCK__DM1, CYREG_PRT4_DM1
.set SCK__DM2, CYREG_PRT4_DM2
.set SCK__DR, CYREG_PRT4_DR
.set SCK__INP_DIS, CYREG_PRT4_INP_DIS
.set SCK__INTTYPE_BASE, CYDEV_PICU_INTTYPE_PICU4_BASE
.set SCK__LCD_COM_SEG, CYREG_PRT4_LCD_COM_SEG
.set SCK__LCD_EN, CYREG_PRT4_LCD_EN
.set SCK__MASK, 0x01
.set SCK__PORT, 4
.set SCK__PRT, CYREG_PRT4_PRT
.set SCK__PRTDSI__CAPS_SEL, CYREG_PRT4_CAPS_SEL
.set SCK__PRTDSI__DBL_SYNC_IN, CYREG_PRT4_DBL_SYNC_IN
.set SCK__PRTDSI__OE_SEL0, CYREG_PRT4_OE_SEL0
.set SCK__PRTDSI__OE_SEL1, CYREG_PRT4_OE_SEL1
.set SCK__PRTDSI__OUT_SEL0, CYREG_PRT4_OUT_SEL0
.set SCK__PRTDSI__OUT_SEL1, CYREG_PRT4_OUT_SEL1
.set SCK__PRTDSI__SYNC_OUT, CYREG_PRT4_SYNC_OUT
.set SCK__PS, CYREG_PRT4_PS
.set SCK__SHIFT, 0
.set SCK__SLW, CYREG_PRT4_SLW

/* SDI */
.set SDI__0__INTTYPE, CYREG_PICU5_INTTYPE0
.set SDI__0__MASK, 0x01
.set SDI__0__PC, CYREG_PRT5_PC0
.set SDI__0__PORT, 5
.set SDI__0__SHIFT, 0
.set SDI__AG, CYREG_PRT5_AG
.set SDI__AMUX, CYREG_PRT5_AMUX
.set SDI__BIE, CYREG_PRT5_BIE
.set SDI__BIT_MASK, CYREG_PRT5_BIT_MASK
.set SDI__BYP, CYREG_PRT5_BYP
.set SDI__CTL, CYREG_PRT5_CTL
.set SDI__DM0, CYREG_PRT5_DM0
.set SDI__DM1, CYREG_PRT5_DM1
.set SDI__DM2, CYREG_PRT5_DM2
.set SDI__DR, CYREG_PRT5_DR
.set SDI__INP_DIS, CYREG_PRT5_INP_DIS
.set SDI__INTTYPE_BASE, CYDEV_PICU_INTTYPE_PICU5_BASE
.set SDI__LCD_COM_SEG, CYREG_PRT5_LCD_COM_SEG
.set SDI__LCD_EN, CYREG_PRT5_LCD_EN
.set SDI__MASK, 0x01
.set SDI__PORT, 5
.set SDI__PRT, CYREG_PRT5_PRT
.set SDI__PRTDSI__CAPS_SEL, CYREG_PRT5_CAPS_SEL
.set SDI__PRTDSI__DBL_SYNC_IN, CYREG_PRT5_DBL_SYNC_IN
.set SDI__PRTDSI__OE_SEL0, CYREG_PRT5_OE_SEL0
.set SDI__PRTDSI__OE_SEL1, CYREG_PRT5_OE_SEL1
.set SDI__PRTDSI__OUT_SEL0, CYREG_PRT5_OUT_SEL0
.set SDI__PRTDSI__OUT_SEL1, CYREG_PRT5_OUT_SEL1
.set SDI__PRTDSI__SYNC_OUT, CYREG_PRT5_SYNC_OUT
.set SDI__PS, CYREG_PRT5_PS
.set SDI__SHIFT, 0
.set SDI__SLW, CYREG_PRT5_SLW

/* SDO */
.set SDO__0__INTTYPE, CYREG_PICU4_INTTYPE1
.set SDO__0__MASK, 0x02
.set SDO__0__PC, CYREG_PRT4_PC1
.set SDO__0__PORT, 4
.set SDO__0__SHIFT, 1
.set SDO__AG, CYREG_PRT4_AG
.set SDO__AMUX, CYREG_PRT4_AMUX
.set SDO__BIE, CYREG_PRT4_BIE
.set SDO__BIT_MASK, CYREG_PRT4_BIT_MASK
.set SDO__BYP, CYREG_PRT4_BYP
.set SDO__CTL, CYREG_PRT4_CTL
.set SDO__DM0, CYREG_PRT4_DM0
.set SDO__DM1, CYREG_PRT4_DM1
.set SDO__DM2, CYREG_PRT4_DM2
.set SDO__DR, CYREG_PRT4_DR
.set SDO__INP_DIS, CYREG_PRT4_INP_DIS
.set SDO__INTTYPE_BASE, CYDEV_PICU_INTTYPE_PICU4_BASE
.set SDO__LCD_COM_SEG, CYREG_PRT4_LCD_COM_SEG
.set SDO__LCD_EN, CYREG_PRT4_LCD_EN
.set SDO__MASK, 0x02
.set SDO__PORT, 4
.set SDO__PRT, CYREG_PRT4_PRT
.set SDO__PRTDSI__CAPS_SEL, CYREG_PRT4_CAPS_SEL
.set SDO__PRTDSI__DBL_SYNC_IN, CYREG_PRT4_DBL_SYNC_IN
.set SDO__PRTDSI__OE_SEL0, CYREG_PRT4_OE_SEL0
.set SDO__PRTDSI__OE_SEL1, CYREG_PRT4_OE_SEL1
.set SDO__PRTDSI__OUT_SEL0, CYREG_PRT4_OUT_SEL0
.set SDO__PRTDSI__OUT_SEL1, CYREG_PRT4_OUT_SEL1
.set SDO__PRTDSI__SYNC_OUT, CYREG_PRT4_SYNC_OUT
.set SDO__PS, CYREG_PRT4_PS
.set SDO__SHIFT, 1
.set SDO__SLW, CYREG_PRT4_SLW

/* UART_BUART */
.set UART_BUART_sTX_sCLOCK_TxBitClkGen__16BIT_A0_REG, CYREG_B0_UDB00_01_A0
.set UART_BUART_sTX_sCLOCK_TxBitClkGen__16BIT_A1_REG, CYREG_B0_UDB00_01_A1
.set UART_BUART_sTX_sCLOCK_TxBitClkGen__16BIT_D0_REG, CYREG_B0_UDB00_01_D0
.set UART_BUART_sTX_sCLOCK_TxBitClkGen__16BIT_D1_REG, CYREG_B0_UDB00_01_D1
.set UART_BUART_sTX_sCLOCK_TxBitClkGen__16BIT_DP_AUX_CTL_REG, CYREG_B0_UDB00_01_ACTL
.set UART_BUART_sTX_sCLOCK_TxBitClkGen__16BIT_F0_REG, CYREG_B0_UDB00_01_F0
.set UART_BUART_sTX_sCLOCK_TxBitClkGen__16BIT_F1_REG, CYREG_B0_UDB00_01_F1
.set UART_BUART_sTX_sCLOCK_TxBitClkGen__A0_A1_REG, CYREG_B0_UDB00_A0_A1
.set UART_BUART_sTX_sCLOCK_TxBitClkGen__A0_REG, CYREG_B0_UDB00_A0
.set UART_BUART_sTX_sCLOCK_TxBitClkGen__A1_REG, CYREG_B0_UDB00_A1
.set UART_BUART_sTX_sCLOCK_TxBitClkGen__D0_D1_REG, CYREG_B0_UDB00_D0_D1
.set UART_BUART_sTX_sCLOCK_TxBitClkGen__D0_REG, CYREG_B0_UDB00_D0
.set UART_BUART_sTX_sCLOCK_TxBitClkGen__D1_REG, CYREG_B0_UDB00_D1
.set UART_BUART_sTX_sCLOCK_TxBitClkGen__DP_AUX_CTL_REG, CYREG_B0_UDB00_ACTL
.set UART_BUART_sTX_sCLOCK_TxBitClkGen__F0_F1_REG, CYREG_B0_UDB00_F0_F1
.set UART_BUART_sTX_sCLOCK_TxBitClkGen__F0_REG, CYREG_B0_UDB00_F0
.set UART_BUART_sTX_sCLOCK_TxBitClkGen__F1_REG, CYREG_B0_UDB00_F1
.set UART_BUART_sTX_TxShifter_u0__16BIT_A0_REG, CYREG_B0_UDB03_04_A0
.set UART_BUART_sTX_TxShifter_u0__16BIT_A1_REG, CYREG_B0_UDB03_04_A1
.set UART_BUART_sTX_TxShifter_u0__16BIT_D0_REG, CYREG_B0_UDB03_04_D0
.set UART_BUART_sTX_TxShifter_u0__16BIT_D1_REG, CYREG_B0_UDB03_04_D1
.set UART_BUART_sTX_TxShifter_u0__16BIT_DP_AUX_CTL_REG, CYREG_B0_UDB03_04_ACTL
.set UART_BUART_sTX_TxShifter_u0__16BIT_F0_REG, CYREG_B0_UDB03_04_F0
.set UART_BUART_sTX_TxShifter_u0__16BIT_F1_REG, CYREG_B0_UDB03_04_F1
.set UART_BUART_sTX_TxShifter_u0__A0_A1_REG, CYREG_B0_UDB03_A0_A1
.set UART_BUART_sTX_TxShifter_u0__A0_REG, CYREG_B0_UDB03_A0
.set UART_BUART_sTX_TxShifter_u0__A1_REG, CYREG_B0_UDB03_A1
.set UART_BUART_sTX_TxShifter_u0__D0_D1_REG, CYREG_B0_UDB03_D0_D1
.set UART_BUART_sTX_TxShifter_u0__D0_REG, CYREG_B0_UDB03_D0
.set UART_BUART_sTX_TxShifter_u0__D1_REG, CYREG_B0_UDB03_D1
.set UART_BUART_sTX_TxShifter_u0__DP_AUX_CTL_REG, CYREG_B0_UDB03_ACTL
.set UART_BUART_sTX_TxShifter_u0__F0_F1_REG, CYREG_B0_UDB03_F0_F1
.set UART_BUART_sTX_TxShifter_u0__F0_REG, CYREG_B0_UDB03_F0
.set UART_BUART_sTX_TxShifter_u0__F1_REG, CYREG_B0_UDB03_F1
.set UART_BUART_sTX_TxSts__0__MASK, 0x01
.set UART_BUART_sTX_TxSts__0__POS, 0
.set UART_BUART_sTX_TxSts__1__MASK, 0x02
.set UART_BUART_sTX_TxSts__1__POS, 1
.set UART_BUART_sTX_TxSts__16BIT_STATUS_AUX_CTL_REG, CYREG_B0_UDB04_05_ACTL
.set UART_BUART_sTX_TxSts__16BIT_STATUS_REG, CYREG_B0_UDB04_05_ST
.set UART_BUART_sTX_TxSts__2__MASK, 0x04
.set UART_BUART_sTX_TxSts__2__POS, 2
.set UART_BUART_sTX_TxSts__3__MASK, 0x08
.set UART_BUART_sTX_TxSts__3__POS, 3
.set UART_BUART_sTX_TxSts__MASK, 0x0F
.set UART_BUART_sTX_TxSts__MASK_REG, CYREG_B0_UDB04_MSK
.set UART_BUART_sTX_TxSts__STATUS_AUX_CTL_REG, CYREG_B0_UDB04_ACTL
.set UART_BUART_sTX_TxSts__STATUS_REG, CYREG_B0_UDB04_ST

/* UART_IntClock */
.set UART_IntClock__CFG0, CYREG_CLKDIST_DCFG2_CFG0
.set UART_IntClock__CFG1, CYREG_CLKDIST_DCFG2_CFG1
.set UART_IntClock__CFG2, CYREG_CLKDIST_DCFG2_CFG2
.set UART_IntClock__CFG2_SRC_SEL_MASK, 0x07
.set UART_IntClock__INDEX, 0x02
.set UART_IntClock__PM_ACT_CFG, CYREG_PM_ACT_CFG2
.set UART_IntClock__PM_ACT_MSK, 0x04
.set UART_IntClock__PM_STBY_CFG, CYREG_PM_STBY_CFG2
.set UART_IntClock__PM_STBY_MSK, 0x04

/* RxDMA */
.set RxDMA__DRQ_CTL, CYREG_IDMUX_DRQ_CTL0
.set RxDMA__DRQ_NUMBER, 0
.set RxDMA__NUMBEROF_TDS, 0
.set RxDMA__PRIORITY, 2
.set RxDMA__TERMIN_EN, 0
.set RxDMA__TERMIN_SEL, 0
.set RxDMA__TERMOUT0_EN, 0
.set RxDMA__TERMOUT0_SEL, 0
.set RxDMA__TERMOUT1_EN, 0
.set RxDMA__TERMOUT1_SEL, 0

/* TxDMA_0 */
.set TxDMA_0__DRQ_CTL, CYREG_IDMUX_DRQ_CTL0
.set TxDMA_0__DRQ_NUMBER, 1
.set TxDMA_0__NUMBEROF_TDS, 0
.set TxDMA_0__PRIORITY, 2
.set TxDMA_0__TERMIN_EN, 0
.set TxDMA_0__TERMIN_SEL, 0
.set TxDMA_0__TERMOUT0_EN, 0
.set TxDMA_0__TERMOUT0_SEL, 0
.set TxDMA_0__TERMOUT1_EN, 0
.set TxDMA_0__TERMOUT1_SEL, 0

/* TxDMA_1 */
.set TxDMA_1__DRQ_CTL, CYREG_IDMUX_DRQ_CTL0
.set TxDMA_1__DRQ_NUMBER, 2
.set TxDMA_1__NUMBEROF_TDS, 0
.set TxDMA_1__PRIORITY, 2
.set TxDMA_1__TERMIN_EN, 0
.set TxDMA_1__TERMIN_SEL, 0
.set TxDMA_1__TERMOUT0_EN, 0
.set TxDMA_1__TERMOUT0_SEL, 0
.set TxDMA_1__TERMOUT1_EN, 0
.set TxDMA_1__TERMOUT1_SEL, 0

/* WaveDAC8_DacClk */
.set WaveDAC8_DacClk__CFG0, CYREG_CLKDIST_DCFG3_CFG0
.set WaveDAC8_DacClk__CFG1, CYREG_CLKDIST_DCFG3_CFG1
.set WaveDAC8_DacClk__CFG2, CYREG_CLKDIST_DCFG3_CFG2
.set WaveDAC8_DacClk__CFG2_SRC_SEL_MASK, 0x07
.set WaveDAC8_DacClk__INDEX, 0x03
.set WaveDAC8_DacClk__PM_ACT_CFG, CYREG_PM_ACT_CFG2
.set WaveDAC8_DacClk__PM_ACT_MSK, 0x08
.set WaveDAC8_DacClk__PM_STBY_CFG, CYREG_PM_STBY_CFG2
.set WaveDAC8_DacClk__PM_STBY_MSK, 0x08

/* WaveDAC8_VDAC8_viDAC8 */
.set WaveDAC8_VDAC8_viDAC8__CR0, CYREG_DAC2_CR0
.set WaveDAC8_VDAC8_viDAC8__CR1, CYREG_DAC2_CR1
.set WaveDAC8_VDAC8_viDAC8__D, CYREG_DAC2_D
.set WaveDAC8_VDAC8_viDAC8__PM_ACT_CFG, CYREG_PM_ACT_CFG8
.set WaveDAC8_VDAC8_viDAC8__PM_ACT_MSK, 0x04
.set WaveDAC8_VDAC8_viDAC8__PM_STBY_CFG, CYREG_PM_STBY_CFG8
.set WaveDAC8_VDAC8_viDAC8__PM_STBY_MSK, 0x04
.set WaveDAC8_VDAC8_viDAC8__STROBE, CYREG_DAC2_STROBE
.set WaveDAC8_VDAC8_viDAC8__SW0, CYREG_DAC2_SW0
.set WaveDAC8_VDAC8_viDAC8__SW2, CYREG_DAC2_SW2
.set WaveDAC8_VDAC8_viDAC8__SW3, CYREG_DAC2_SW3
.set WaveDAC8_VDAC8_viDAC8__SW4, CYREG_DAC2_SW4
.set WaveDAC8_VDAC8_viDAC8__TR, CYREG_DAC2_TR
.set WaveDAC8_VDAC8_viDAC8__TRIM__M1, CYREG_FLSHID_CUST_TABLES_DAC2_M1
.set WaveDAC8_VDAC8_viDAC8__TRIM__M2, CYREG_FLSHID_CUST_TABLES_DAC2_M2
.set WaveDAC8_VDAC8_viDAC8__TRIM__M3, CYREG_FLSHID_CUST_TABLES_DAC2_M3
.set WaveDAC8_VDAC8_viDAC8__TRIM__M4, CYREG_FLSHID_CUST_TABLES_DAC2_M4
.set WaveDAC8_VDAC8_viDAC8__TRIM__M5, CYREG_FLSHID_CUST_TABLES_DAC2_M5
.set WaveDAC8_VDAC8_viDAC8__TRIM__M6, CYREG_FLSHID_CUST_TABLES_DAC2_M6
.set WaveDAC8_VDAC8_viDAC8__TRIM__M7, CYREG_FLSHID_CUST_TABLES_DAC2_M7
.set WaveDAC8_VDAC8_viDAC8__TRIM__M8, CYREG_FLSHID_CUST_TABLES_DAC2_M8
.set WaveDAC8_VDAC8_viDAC8__TST, CYREG_DAC2_TST

/* WaveDAC8_Wave1_DMA */
.set WaveDAC8_Wave1_DMA__DRQ_CTL, CYREG_IDMUX_DRQ_CTL0
.set WaveDAC8_Wave1_DMA__DRQ_NUMBER, 3
.set WaveDAC8_Wave1_DMA__NUMBEROF_TDS, 0
.set WaveDAC8_Wave1_DMA__PRIORITY, 2
.set WaveDAC8_Wave1_DMA__TERMIN_EN, 0
.set WaveDAC8_Wave1_DMA__TERMIN_SEL, 0
.set WaveDAC8_Wave1_DMA__TERMOUT0_EN, 0
.set WaveDAC8_Wave1_DMA__TERMOUT0_SEL, 0
.set WaveDAC8_Wave1_DMA__TERMOUT1_EN, 0
.set WaveDAC8_Wave1_DMA__TERMOUT1_SEL, 0

/* WaveDAC8_Wave2_DMA */
.set WaveDAC8_Wave2_DMA__DRQ_CTL, CYREG_IDMUX_DRQ_CTL1
.set WaveDAC8_Wave2_DMA__DRQ_NUMBER, 4
.set WaveDAC8_Wave2_DMA__NUMBEROF_TDS, 0
.set WaveDAC8_Wave2_DMA__PRIORITY, 2
.set WaveDAC8_Wave2_DMA__TERMIN_EN, 0
.set WaveDAC8_Wave2_DMA__TERMIN_SEL, 0
.set WaveDAC8_Wave2_DMA__TERMOUT0_EN, 0
.set WaveDAC8_Wave2_DMA__TERMOUT0_SEL, 0
.set WaveDAC8_Wave2_DMA__TERMOUT1_EN, 0
.set WaveDAC8_Wave2_DMA__TERMOUT1_SEL, 0

/* Wave_Output */
.set Wave_Output__0__INTTYPE, CYREG_PICU1_INTTYPE6
.set Wave_Output__0__MASK, 0x40
.set Wave_Output__0__PC, CYREG_PRT1_PC6
.set Wave_Output__0__PORT, 1
.set Wave_Output__0__SHIFT, 6
.set Wave_Output__AG, CYREG_PRT1_AG
.set Wave_Output__AMUX, CYREG_PRT1_AMUX
.set Wave_Output__BIE, CYREG_PRT1_BIE
.set Wave_Output__BIT_MASK, CYREG_PRT1_BIT_MASK
.set Wave_Output__BYP, CYREG_PRT1_BYP
.set Wave_Output__CTL, CYREG_PRT1_CTL
.set Wave_Output__DM0, CYREG_PRT1_DM0
.set Wave_Output__DM1, CYREG_PRT1_DM1
.set Wave_Output__DM2, CYREG_PRT1_DM2
.set Wave_Output__DR, CYREG_PRT1_DR
.set Wave_Output__INP_DIS, CYREG_PRT1_INP_DIS
.set Wave_Output__INTTYPE_BASE, CYDEV_PICU_INTTYPE_PICU1_BASE
.set Wave_Output__LCD_COM_SEG, CYREG_PRT1_LCD_COM_SEG
.set Wave_Output__LCD_EN, CYREG_PRT1_LCD_EN
.set Wave_Output__MASK, 0x40
.set Wave_Output__PORT, 1
.set Wave_Output__PRT, CYREG_PRT1_PRT
.set Wave_Output__PRTDSI__CAPS_SEL, CYREG_PRT1_CAPS_SEL
.set Wave_Output__PRTDSI__DBL_SYNC_IN, CYREG_PRT1_DBL_SYNC_IN
.set Wave_Output__PRTDSI__OE_SEL0, CYREG_PRT1_OE_SEL0
.set Wave_Output__PRTDSI__OE_SEL1, CYREG_PRT1_OE_SEL1
.set Wave_Output__PRTDSI__OUT_SEL0, CYREG_PRT1_OUT_SEL0
.set Wave_Output__PRTDSI__OUT_SEL1, CYREG_PRT1_OUT_SEL1
.set Wave_Output__PRTDSI__SYNC_OUT, CYREG_PRT1_SYNC_OUT
.set Wave_Output__PS, CYREG_PRT1_PS
.set Wave_Output__SHIFT, 6
.set Wave_Output__SLW, CYREG_PRT1_SLW

/* Miscellaneous */
.set BCLK__BUS_CLK__HZ, 24000000
.set BCLK__BUS_CLK__KHZ, 24000
.set BCLK__BUS_CLK__MHZ, 24
.set CYDEV_CHIP_DIE_LEOPARD, 1
.set CYDEV_CHIP_DIE_PANTHER, 18
.set CYDEV_CHIP_DIE_PSOC4A, 10
.set CYDEV_CHIP_DIE_PSOC5LP, 17
.set CYDEV_CHIP_DIE_TMA4, 2
.set CYDEV_CHIP_DIE_UNKNOWN, 0
.set CYDEV_CHIP_FAMILY_PSOC3, 1
.set CYDEV_CHIP_FAMILY_PSOC4, 2
.set CYDEV_CHIP_FAMILY_PSOC5, 3
.set CYDEV_CHIP_FAMILY_UNKNOWN, 0
.set CYDEV_CHIP_FAMILY_USED, CYDEV_CHIP_FAMILY_PSOC5
.set CYDEV_CHIP_JTAG_ID, 0x2E123069
.set CYDEV_CHIP_MEMBER_3A, 1
.set CYDEV_CHIP_MEMBER_4A, 10
.set CYDEV_CHIP_MEMBER_4C, 15
.set CYDEV_CHIP_MEMBER_4D, 6
.set CYDEV_CHIP_MEMBER_4E, 4
.set CYDEV_CHIP_MEMBER_4F, 11
.set CYDEV_CHIP_MEMBER_4G, 2
.set CYDEV_CHIP_MEMBER_4H, 9
.set CYDEV_CHIP_MEMBER_4I, 14
.set CYDEV_CHIP_MEMBER_4J, 7
.set CYDEV_CHIP_MEMBER_4K, 8
.set CYDEV_CHIP_MEMBER_4L, 13
.set CYDEV_CHIP_MEMBER_4M, 12
.set CYDEV_CHIP_MEMBER_4N, 5
.set CYDEV_CHIP_MEMBER_4U, 3
.set CYDEV_CHIP_MEMBER_5A, 17
.set CYDEV_CHIP_MEMBER_5B, 16
.set CYDEV_CHIP_MEMBER_UNKNOWN, 0
.set CYDEV_CHIP_MEMBER_USED, CYDEV_CHIP_MEMBER_5B
.set CYDEV_CHIP_DIE_EXPECT, CYDEV_CHIP_MEMBER_USED
.set CYDEV_CHIP_DIE_ACTUAL, CYDEV_CHIP_DIE_EXPECT
.set CYDEV_CHIP_REV_LEOPARD_ES1, 0
.set CYDEV_CHIP_REV_LEOPARD_ES2, 1
.set CYDEV_CHIP_REV_LEOPARD_ES3, 3
.set CYDEV_CHIP_REV_LEOPARD_PRODUCTION, 3
.set CYDEV_CHIP_REV_PANTHER_ES0, 0
.set CYDEV_CHIP_REV_PANTHER_ES1, 1
.set CYDEV_CHIP_REV_PANTHER_PRODUCTION, 1
.set CYDEV_CHIP_REV_PSOC4A_ES0, 17
.set CYDEV_CHIP_REV_PSOC4A_PRODUCTION, 17
.set CYDEV_CHIP_REV_PSOC5LP_ES0, 0
.set CYDEV_CHIP_REV_PSOC5LP_PRODUCTION, 0
.set CYDEV_CHIP_REV_TMA4_ES, 17
.set CYDEV_CHIP_REV_TMA4_ES2, 33
.set CYDEV_CHIP_REV_TMA4_PRODUCTION, 17
.set CYDEV_CHIP_REVISION_3A_ES1, 0
.set CYDEV_CHIP_REVISION_3A_ES2, 1
.set CYDEV_CHIP_REVISION_3A_ES3, 3
.set CYDEV_CHIP_REVISION_3A_PRODUCTION, 3
.set CYDEV_CHIP_REVISION_4A_ES0, 17
.set CYDEV_CHIP_REVISION_4A_PRODUCTION, 17
.set CYDEV_CHIP_REVISION_4C_PRODUCTION, 0
.set CYDEV_CHIP_REVISION_4D_PRODUCTION, 0
.set CYDEV_CHIP_REVISION_4E_PRODUCTION, 0
.set CYDEV_CHIP_REVISION_4F_PRODUCTION, 0
.set CYDEV_CHIP_REVISION_4F_PRODUCTION_256DMA, 0
.set CYDEV_CHIP_REVISION_4F_PRODUCTION_256K, 0
.set CYDEV_CHIP_REVISION_4G_ES, 17
.set CYDEV_CHIP_REVISION_4G_ES2, 33
.set CYDEV_CHIP_REVISION_4G_PRODUCTION, 17
.set CYDEV_CHIP_REVISION_4H_PRODUCTION, 0
.set CYDEV_CHIP_REVISION_4I_PRODUCTION, 0
.set CYDEV_CHIP_REVISION_4J_PRODUCTION, 0
.set CYDEV_CHIP_REVISION_4K_PRODUCTION, 0
.set CYDEV_CHIP_REVISION_4L_PRODUCTION, 0
.set CYDEV_CHIP_REVISION_4M_PRODUCTION, 0
.set CYDEV_CHIP_REVISION_4N_PRODUCTION, 0
.set CYDEV_CHIP_REVISION_4U_PRODUCTION, 0
.set CYDEV_CHIP_REVISION_5A_ES0, 0
.set CYDEV_CHIP_REVISION_5A_ES1, 1
.set CYDEV_CHIP_REVISION_5A_PRODUCTION, 1
.set CYDEV_CHIP_REVISION_5B_ES0, 0
.set CYDEV_CHIP_REVISION_5B_PRODUCTION, 0
.set CYDEV_CHIP_REVISION_USED, CYDEV_CHIP_REVISION_5B_PRODUCTION
.set CYDEV_CHIP_REV_EXPECT, CYDEV_CHIP_REVISION_USED
.set CYDEV_CONFIG_FASTBOOT_ENABLED, 1
.set CYDEV_CONFIG_UNUSED_IO_AllowButWarn, 0
.set CYDEV_CONFIG_UNUSED_IO, CYDEV_CONFIG_UNUSED_IO_AllowButWarn
.set CYDEV_CONFIG_UNUSED_IO_AllowWithInfo, 1
.set CYDEV_CONFIG_UNUSED_IO_Disallowed, 2
.set CYDEV_CONFIGURATION_COMPRESSED, 1
.set CYDEV_CONFIGURATION_DMA, 0
.set CYDEV_CONFIGURATION_ECC, 1
.set CYDEV_CONFIGURATION_IMOENABLED, CYDEV_CONFIG_FASTBOOT_ENABLED
.set CYDEV_CONFIGURATION_MODE_COMPRESSED, 0
.set CYDEV_CONFIGURATION_MODE, CYDEV_CONFIGURATION_MODE_COMPRESSED
.set CYDEV_CONFIGURATION_MODE_DMA, 2
.set CYDEV_CONFIGURATION_MODE_UNCOMPRESSED, 1
.set CYDEV_DEBUG_ENABLE_MASK, 0x20
.set CYDEV_DEBUG_ENABLE_REGISTER, CYREG_MLOGIC_DEBUG
.set CYDEV_DEBUGGING_DPS_Disable, 3
.set CYDEV_DEBUGGING_DPS_JTAG_4, 1
.set CYDEV_DEBUGGING_DPS_JTAG_5, 0
.set CYDEV_DEBUGGING_DPS_SWD, 2
.set CYDEV_DEBUGGING_DPS_SWD_SWV, 6
.set CYDEV_DEBUGGING_DPS, CYDEV_DEBUGGING_DPS_SWD_SWV
.set CYDEV_DEBUGGING_ENABLE, 1
.set CYDEV_DEBUGGING_XRES, 0
.set CYDEV_DMA_CHANNELS_AVAILABLE, 24
.set CYDEV_ECC_ENABLE, 0
.set CYDEV_HEAP_SIZE, 0x1000
.set CYDEV_INSTRUCT_CACHE_ENABLED, 1
.set CYDEV_INTR_RISING, 0x00000000
.set CYDEV_IS_EXPORTING_CODE, 0
.set CYDEV_IS_IMPORTING_CODE, 0
.set CYDEV_PROJ_TYPE, 0
.set CYDEV_PROJ_TYPE_BOOTLOADER, 1
.set CYDEV_PROJ_TYPE_LAUNCHER, 5
.set CYDEV_PROJ_TYPE_LOADABLE, 2
.set CYDEV_PROJ_TYPE_LOADABLEANDBOOTLOADER, 4
.set CYDEV_PROJ_TYPE_MULTIAPPBOOTLOADER, 3
.set CYDEV_PROJ_TYPE_STANDARD, 0
.set CYDEV_PROTECTION_ENABLE, 0
.set CYDEV_STACK_SIZE, 0x4000
.set CYDEV_USB_CLK_OSC_LOCKING_ENABLED_AT_PWR_UP, 1
.set CYDEV_USE_BUNDLED_CMSIS, 1
.set CYDEV_VARIABLE_VDDA, 0
.set CYDEV_VDDA_MV, 5000
.set CYDEV_VDDD_MV, 5000
.set CYDEV_VDDIO0_MV, 5000
.set CYDEV_VDDIO1_MV, 5000
.set CYDEV_VDDIO2_MV, 5000
.set CYDEV_VDDIO3_MV, 5000
.set CYDEV_VIO0_MV, 5000
.set CYDEV_VIO1_MV, 5000
.set CYDEV_VIO2_MV, 5000
.set CYDEV_VIO3_MV, 5000
.set CYIPBLOCK_ARM_CM3_VERSION, 0
.set CYIPBLOCK_P3_ANAIF_VERSION, 0
.set CYIPBLOCK_P3_CAN_VERSION, 0
.set CYIPBLOCK_P3_CAPSENSE_VERSION, 0
.set CYIPBLOCK_P3_COMP_VERSION, 0
.set CYIPBLOCK_P3_DECIMATOR_VERSION, 0
.set CYIPBLOCK_P3_DFB_VERSION, 0
.set CYIPBLOCK_P3_DMA_VERSION, 0
.set CYIPBLOCK_P3_DRQ_VERSION, 0
.set CYIPBLOCK_P3_DSM_VERSION, 0
.set CYIPBLOCK_P3_EMIF_VERSION, 0
.set CYIPBLOCK_P3_I2C_VERSION, 0
.set CYIPBLOCK_P3_LCD_VERSION, 0
.set CYIPBLOCK_P3_LPF_VERSION, 0
.set CYIPBLOCK_P3_OPAMP_VERSION, 0
.set CYIPBLOCK_P3_PM_VERSION, 0
.set CYIPBLOCK_P3_SCCT_VERSION, 0
.set CYIPBLOCK_P3_TIMER_VERSION, 0
.set CYIPBLOCK_P3_USB_VERSION, 0
.set CYIPBLOCK_P3_VIDAC_VERSION, 0
.set CYIPBLOCK_P3_VREF_VERSION, 0
.set CYIPBLOCK_S8_GPIO_VERSION, 0
.set CYIPBLOCK_S8_IRQ_VERSION, 0
.set CYIPBLOCK_S8_SAR_VERSION, 0
.set CYIPBLOCK_S8_SIO_VERSION, 0
.set CYIPBLOCK_S8_UDB_VERSION, 0
.set DMA_CHANNELS_USED__MASK0, 0x0000001F
.set CYDEV_BOOTLOADER_ENABLE, 0
.endif
